## f1c100s/Kconfig
```kconfig
mainmenu "RT-Thread Configuration"

config $BSP_DIR
    string
    default "."

config $RTT_DIR
    string
    default "../"

# you can change the RTT_ROOT default "../.." to your rtthread_root,
# example : default "F:/git_repositories/rt-thread"

config PKGS_DIR
    string
    option env="PKGS_ROOT"
    default "packages"

source "$RTT_DIR/Kconfig"
source "$PKGS_DIR/Kconfig"

config ARCH_ARM_ARM9
    bool
    select RT_USING_COMPONENTS_INIT
    select RT_USING_USER_MAIN
    select ARCH_ARM
    default y

source "$BSP_DIR/drivers/Kconfig"
```

## f1c100s/drivers/Kconfig
```kconfig
config CONFIG_SOC_AW1663
    bool
    default y

config TINA_USING_UART0
    bool "Using UART0"
    select RT_USING_SERIAL
    default n

config TINA_USING_UART1
    bool "Using UART1"
    select RT_USING_SERIAL
    default n

config TINA_USING_UART2
    bool "Using UART2"
    select RT_USING_SERIAL
    default y

config RT_USING_CPU_FFS
    bool "Using CPU FFS"
    default n
```
